## firmware/c5_power_stages_hb/04_remote_power/sdkconfig.defaults
```kconfig
CONFIG_IDF_TARGET="esp32c5"
CONFIG_PARTITION_TABLE_SINGLE_APP_LARGE=y
CONFIG_ESPTOOLPY_FLASHSIZE_16MB=y
CONFIG_CAMPUS_WIFI_OPEN=y
CONFIG_CAMPUS_WIFI_SSID="YourCampusWiFi"
CONFIG_SG90_GPIO=24
CONFIG_SG90_IDLE_US=1500
CONFIG_SG90_PRESS_US=1600
```

## firmware/c5_power_stages_hb/components/campus_wifi/Kconfig.projbuild
```kconfig
menu "Campus Wi-Fi"

    config CAMPUS_WIFI_OPEN
        bool "Connect to an open access point"
        default n

    config CAMPUS_WIFI_SSID
        string "Wi-Fi SSID"
        default "YourCampusWiFi-5G"

    config CAMPUS_WIFI_USERNAME
        string "Campus Wi-Fi username"
        default ""

    config CAMPUS_WIFI_PASSWORD
        string "Campus Wi-Fi password"
        default ""

    config CAMPUS_WIFI_OUTER_IDENTITY
        string "PEAP outer identity (optional)"
        default ""
        help
            Leave empty to use the campus username unless the network operator
            provides a separate outer identity.

    config CAMPUS_WIFI_RADIUS_DOMAIN
        string "RADIUS server certificate domain"
        default ""
        help
            Use the certificate hostname or domain supplied by the network operator.
            A custom CA in components/campus_wifi/campus_ca.pem takes precedence over the ESP-IDF
            public CA bundle. Connection is disabled when this field is empty.

endmenu
```

## firmware/c5_power_stages_hb/components/power_mqtt/Kconfig.projbuild
```kconfig
menu "Power MQTT"

    config POWER_MQTT_URI
        string "Broker URI (mqtts://hostname:port)"
        default ""

    config POWER_MQTT_USERNAME
        string "MQTT device username"
        default ""

    config POWER_MQTT_PASSWORD
        string "MQTT device password"
        default ""

    config POWER_MQTT_TOPIC_BASE
        string "Topic prefix (no trailing slash)"
        default ""

    config POWER_MQTT_SNTP_SERVER
        string "SNTP server hostname"
        default "pool.ntp.org"

endmenu
```

## firmware/c5_power_stages_hb/components/sg90/Kconfig.projbuild
```kconfig
menu "SG90 Servo"

    config SG90_GPIO
        int "PWM signal GPIO (-1 = unset)"
        range -1 28
        default -1

    config SG90_IDLE_US
        int "Released position pulse (microseconds)"
        range 900 2100
        default 1500

    config SG90_PRESS_US
        int "Pressed position pulse (microseconds, 0 = unset)"
        range 0 2100
        default 0

endmenu
```
